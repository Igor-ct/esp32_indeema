## components/BLE_BT/Kconfig.projbuild
```kconfig
menu "BLE Component Configuration"

    config BLE_DEVICE_NAME
        string "BLE Device Name (Advertising)"
        default "ESP32_Igor_BLE"

    config BLE_MANUFACTURER_NAME
        string "Manufacturer Name"
        default "My Company"

    config BLE_MODEL_NUMBER
        string "Model Number"
        default "ESP32 NimBLE LED"

endmenu
```

## components/UI/joystick_button/Kconfig
```kconfig
menu "Button Configuration"

config BUTTON_GPIO
    int "Button GPIO"
    default 6

config BUTTON_ACTIVE_LEVEL
    int "Button Active Level (0=LOW, 1=HIGH)"
    default 0
    range 0 1

config BUTTON_LONG_PRESS_TIME
    int "Long Press Time (ms)"
    default 4000

config BUTTON_SHORT_PRESS_TIME
    int "Short Press Time (ms)"
    default 500
endmenu
```

## components/UI/joystick_controller/Kconfig
```kconfig
menu "Joystick Configuration"

config JOYSTICK_ADC_UNIT
    int "ADC Unit (1 or 2)"
    default 1
    range 1 2

config JOYSTICK_X_CHANNEL
    int "Joystick X ADC Channel"
    default 0

config JOYSTICK_Y_CHANNEL
    int "Joystick Y ADC Channel"
    default 1

config JOYSTICK_UPDATE_INTERVAL
    int "Joystick update interval (ms)"
    default 100

config JOYSTICK_ENABLE_CIRCLE_MODE
    bool "Enable RGB circle mode by default"
    default y

config JOYSTICK_ENABLE_WIFI_MODE
    bool "Enable wifi mode control by default"
    default y

endmenu
```

## components/app/https_ota/Kconfig
```kconfig
menu "OTA Configuration"

    config FIRMWARE_UPGRADE_URL
        string "Default Firmware Upgrade URL"
        default "https://your-server.com/firmware.bin"
        help
            URL for downloading OTA firmware updates.

    config SKIP_COMMON_NAME_CHECK
        bool "Skip server certificate common name check"
        default n
        help
            Skip the common name check of the server certificate. Useful for testing with self-signed certs.

    config OTA_RECV_TIMEOUT
        int "OTA Receive Timeout (ms)"
        default 10000
        help
            Timeout for receiving OTA data over HTTPS.

endmenu
```

## components/app/sensor_service/Kconfig
```kconfig
menu "Sensor Service Configuration"

config SENSOR_ENABLE_AHT20
    bool "Enable AHT20 sensor"
    default y

config SENSOR_ENABLE_BMP280
    bool "Enable BMP280 sensor"
    default y

config SENSOR_ENABLE_LSM6DS3
    bool "Enable LSM6DS3 sensor"
    default y

endmenu
```

## components/app/telemetry_service/Kconfig
```kconfig
menu "Telemetry Service Configuration"

config UPDATE_ENV_TELEMETRY
    int "Environment telemetry update interval (ms)"
    default 5000
    help
      Interval in milliseconds for updating temperature, humidity, and pressure telemetry.

config UPDATE_MOTION_TELEMETRY_TIME
    int "Motion telemetry update interval (ms)"
    default 200
    help
      Interval in milliseconds for updating accelerometer telemetry.

endmenu
```

## components/drivers/sg92r/Kconfig
```kconfig
menu "Servo Motor (SG92R) Configuration"

    config SG92R_PWM_PIN
        int "PWM GPIO Pin"
        default 21
        help
            GPIO pin connected to the PWM signal wire of the SG92R servo.

endmenu
```

## components/drivers/stepper_28byj48/Kconfig
```kconfig
menu "Stepper Motor (28BYJ-48) Configuration"

    config STEPPER_IN1_PIN
        int "IN1 GPIO Pin"
        default 15
        help
            GPIO pin connected to IN1 of the ULN2003 driver.

    config STEPPER_IN2_PIN
        int "IN2 GPIO Pin"
        default 16
        help
            GPIO pin connected to IN2 of the ULN2003 driver.

    config STEPPER_IN3_PIN
        int "IN3 GPIO Pin"
        default 17
        help
            GPIO pin connected to IN3 of the ULN2003 driver.

    config STEPPER_IN4_PIN
        int "IN4 GPIO Pin"
        default 18
        help
            GPIO pin connected to IN4 of the ULN2003 driver.

endmenu
```

## components/hal/spi/Kconfig
```kconfig
menu "Custom SPI Configuration"

config SPI_MISO_PIN
    int "SPI MISO PIN"
    default 13
    range 0 48

config SPI_MOSI_PIN
    int "SPI MOSI PIN"
    default 11
    range 0 48

config SPI_SCLK_PIN
    int "SPI SCLK PIN"
    default 12
    range 0 48

endmenu
```

## components/led2/Kconfig.projbuild
```kconfig
menu "WS2812 LED Configuration"

config LED_WS2812_GPIO
    int "WS2812 GPIO"
    default 48
    range 0 48

config LED_WS2812_MAX_LEDS
    int "Number of LEDs"
    default 1

config LED_WS2812_RMT_RESOLUTION
    int "RMT Resolution (Hz)"
    default 10000000


endmenu
```

## components/led_ctrl/Kconfig.projbuild
```kconfig
menu "Custom LED Configuration"

config MY_LED_ENABLE
    bool "Enable LED control"
    default y
    help
        Enable or disable LED control logic in the application.

config MY_LED_GPIO
    int "LED GPIO Number"
    default 2
    range 0 48
    depends on MY_LED_ENABLE
    help
        GPIO pin number connected to the LED.
        Note: onboard LED GPIO varies by board; check your board schematic/pinout.

config MY_LED_ACTIVE_HIGH
    bool "LED is Active High"
    default y
    depends on MY_LED_ENABLE
    help
        Y: LED turns on when GPIO is high.
        N: LED turns on when GPIO is low.

endmenu
```

## components/my_I2C/Kconfig.projbuild
```kconfig
menu "Custom SPI Configuration"

config I2C_MASTER_SDA_IO
    int "I2C MASTER SDA IO"
    default 8
    range 0 48

config I2C_MASTER_SCL_IO
    int "I2C MASTER SCL IO"
    default 9
    range 0 48

endmenu
```

## components/my_UART/Kconfig.projbuild
```kconfig
menu "Custom UART Configuration"

config UART_BAUD_RATE
    int "UART BAUDRATE"
    default 115200

config MY_TXD_PIN
    int "TXD PIN"
    default 8
    range 0 48

config MY_RXD_PIN
    int "RXD PIN"
    default 2
    range 0 48

endmenu
```

## components/network/mqtt_wrapper/Kconfig
```kconfig
menu "MQTT Configuration"

    config MQTT_BROKER_URI
        string "MQTT broker URI"
        default "mqtt://broker.hivemq.com:1883"

    config MQTT_CLIENT_ID
        string "MQTT broker ID"
        default "ESP32_Test" 

    config MQTT_CMD_TOPIC
        string "MQTT command topic"
        default "esp-lection/cmd"

    config MQTT_STATUS_TOPIC
        string "MQTT status topic"
        default "esp-lection/status"
    
endmenu
```

## components/wifi_ap/Kconfig.projbuild
```kconfig
menu "WIFI_AP Configuration"

    config ESP_WIFI_SSID_AP
        string "WiFi SSID"
        default "myssid"
        help
            SSID (network name).

    config ESP_WIFI_PASSWORD_AP
        string "WiFi Password"
        default "mypassword"
        help
            WiFi password (WPA or WPA2).
    config ESP_WIFI_CHANNEL
        int "WiFi Channel"
        range 1 13
        default 1
        help
            WiFi channel (network channel).

    config ESP_MAX_STA_CONN
        int "Maximal STA connections"
        default 4
        help
            Max number of the STA connects to AP.

    config ESP_GTK_REKEYING_ENABLE
        bool "Enable GTK Rekeying"
        default y
        help
            Flag to enable GTK rekeying.

    config ESP_GTK_REKEY_INTERVAL
        int "GTK rekey interval"
        depends on ESP_GTK_REKEYING_ENABLE
        range 60 65535
        default 600
        help
            GTK rekeying interval in seconds.
endmenu
```

## main/Kconfig.projbuild
```kconfig
menu "Main Configure"

    menu "Network"
      rsource "../components/network/ble/Kconfig"
      rsource "../components/network/wifi_ap/Kconfig"
      rsource "../components/network/wifi_sta/Kconfig"
      rsource "../components/network/sntp_sync/Kconfig"
      rsource "../components/network/mqtt_wrapper/Kconfig"
   endmenu

   menu "HAL"
      rsource "../components/hal/i2c/Kconfig"
      rsource "../components/hal/spi/Kconfig"
      rsource "../components/hal/uart/Kconfig"
   endmenu

   menu "APP"
      rsource "../components/app/sensor_service/Kconfig"
      rsource "../components/app/telemetry_service/Kconfig"
   endmenu

   menu "UI"
      rsource "../components/ui/joystick_controller/Kconfig"
      rsource "../components/ui/joystick_button/Kconfig"
   endmenu

   menu "Drivers"
      rsource "../components/drivers/ws2812/Kconfig"
      rsource "../components/drivers/sg92r/Kconfig"
      rsource "../components/drivers/stepper_28byj48/Kconfig"
   endmenu

endmenu
```

## sdkconfig.defaults
```kconfig
CONFIG_LOG_DEFAULT_LEVEL=3
CONFIG_LOG_MAXIMUM_LEVEL=4
CONFIG_BT_ENABLED=y
CONFIG_BT_NIMBLE_ENABLED=y
CONFIG_BT_CONTROLLER_ENABLED=y

CONFIG_PARTITION_TABLE_CUSTOM=y
CONFIG_PARTITION_TABLE_CUSTOM_FILENAME="partitions.csv"
CONFIG_PARTITION_TABLE_FILENAME="partitions.csv"

CONFIG_ESPTOOLPY_FLASHSIZE_16MB=y
CONFIG_ESPTOOLPY_FLASHSIZE="16MB"
CONFIG_ESPTOOLPY_FLASHSIZE_DETECT=y

CONFIG_FREERTOS_HZ=1000
```
